## CMakeLists.txt
```
# SPDX-License-Identifier: Apache-2.0

cmake_minimum_required(VERSION 3.20.0)
find_package(Zephyr REQUIRED HINTS $ENV{ZEPHYR_BASE})
project(central_multilink)

target_sources(app PRIVATE
  src/main.c
  src/app_bt.c
  src/app_bt_ctrl.c
  src/game_whackamole_1p.c
  ../common/src/color.c
)
target_include_directories(app PRIVATE src ../common/include)

zephyr_library_include_directories(${ZEPHYR_BASE}/samples/bluetooth)
```

## prj.conf
```kconfig
CONFIG_BT=y
CONFIG_BT_CENTRAL=y
CONFIG_BT_AUTO_PHY_UPDATE=n
CONFIG_BT_PRIVACY=y

CONFIG_BT_PERIPHERAL=y
CONFIG_BT_DEVICE_NAME="Whack-Central"
CONFIG_BT_DEVICE_APPEARANCE=833
CONFIG_BT_NUS=y

CONFIG_BT_MAX_CONN=8

CONFIG_BT_GATT_CLIENT=y
CONFIG_BT_NUS_CLIENT=y
CONFIG_BT_GATT_DM=y
CONFIG_HEAP_MEM_POOL_SIZE=2048

CONFIG_BT_BUF_ACL_RX_SIZE=502
CONFIG_BT_ATT_PREPARE_COUNT=2
CONFIG_BT_L2CAP_TX_BUF_COUNT=32
CONFIG_BT_L2CAP_TX_MTU=498
CONFIG_BT_CONN_TX_MAX=32
CONFIG_BT_BUF_ACL_TX_COUNT=32
CONFIG_BT_BUF_ACL_TX_SIZE=502

CONFIG_BT_CTLR_DATA_LENGTH_MAX=251
CONFIG_BT_CTLR_PHY_2M=y
CONFIG_BT_CTLR_RX_BUFFERS=2

# CONFIG_BT_SMP=y
# CONFIG_BT_MAX_PAIRED=62

# CONFIG_BT_EXT_ADV=y
# CONFIG_BT_CTLR_ADV_EXT=y

CONFIG_NEWLIB_LIBC=y

CONFIG_DK_LIBRARY=y

CONFIG_LOG=y
CONFIG_LOG_BACKEND_UART=n
CONFIG_LOG_BACKEND_RTT=y
```

## src/main.c
```c
/* main.c - Application main entry point */

/*
 * Copyright (c) 2021 Nordic Semiconductor ASA
 *
 * SPDX-License-Identifier: Apache-2.0
 */

#include <stdint.h>
#include <app_bt.h>
#include <app_bt_ctrl.h>
#include <dk_buttons_and_leds.h>
#include <game_whackamole.h>

static struct game_t mygame;

static void button_changed(uint32_t button_state, uint32_t has_changed)
{
	uint32_t changed_and_pressed = button_state & has_changed;
	
	// If button 1 pressed
	if(changed_and_pressed & DK_BTN1_MSK) {
		app_bt_send_str(0, "test", 4);
	}
}

void on_app_bt_ctrl_event(struct app_bt_ctrl_evt_t *event)
{

}

void on_app_bt_event(struct app_bt_evt_t *event)
{
	switch(event->type) {
		case APP_BT_EVT_CON_NUM_CHANGE:
			mygame.bt_rx(&mygame, event);
			break; 
		case APP_BT_EVT_RX_DATA:
			mygame.bt_rx(&mygame, event);
			break;
		case APP_BT_EVT_CTRL_CONNECTED:
			app_bt_ctrl_connected(event->ctrl_conn);
			break;
		case APP_BT_EVT_CTRL_DISCONNECTED:
			app_bt_ctrl_disconnected(event->ctrl_conn);
			break; 			
	}
}

void on_game_bt_ctrl_send(const uint8_t *data, uint16_t len)
{
	app_bt_ctrl_send_str(data, len);
}

void on_game_bt_send(uint32_t con_index, const uint8_t *data, uint16_t len)
{
#if 0
	printk("BT TX (cond index %i):", con_index);
	for(int i = 0; i < len; i++) {
		if(data[i] > 32 && data[i] < 128) printk("0x%.2X '%c' ", data[i], data[i]);
		else printk("0x%.2X ", data[i]);
	} 
	printk("\n");
#endif
	app_bt_send_str(con_index, data, len);
}

void main(void)
{
	int ret;

	ret = dk_buttons_init(button_changed);
	if (ret < 0) {
		printk("Cannot init buttons (err: %d)\n", ret);
		return;
	}

	ret = app_bt_init(on_app_bt_event);
	if (ret < 0) {
		printk("BT init failed!\n");
		return;
	}

	ret = app_bt_ctrl_init(on_app_bt_ctrl_event);
	if (ret < 0) {
		printk("BT Peripheral init failed!\n");
		return;
	}

	mygame.bt_send = on_game_bt_send;
	mygame.bt_ctrl_send = on_game_bt_ctrl_send;
	whackamole_init(&mygame);

	mygame.play(&mygame);
}
```

## src/app_bt.c
```c
/* main.c - Application main entry point */

/*
 * Copyright (c) 2021 Nordic Semiconductor ASA
 * Copyright (c) 2015-2016 Intel Corporation
 *
 * SPDX-License-Identifier: Apache-2.0
 */

#include <app_bt.h>
#include <zephyr/types.h>
#include <stddef.h>
#include <errno.h>

#include <zephyr/bluetooth/bluetooth.h>
#include <zephyr/bluetooth/hci.h>
#include <zephyr/bluetooth/conn.h>
#include <zephyr/bluetooth/uuid.h>
#include <zephyr/bluetooth/gatt.h>
#include <bluetooth/services/nus.h>
#include <bluetooth/services/nus_client.h>
#include <zephyr/sys/byteorder.h>
#include <zephyr/logging/log.h>

LOG_MODULE_REGISTER(app_bt, LOG_LEVEL_DBG);

#define SCAN_INTERVAL 0x00A0 /* 160 ms */
#define SCAN_WINDOW   0x0030 /* 30 ms */
#define INIT_INTERVAL 0x0010 /* 10 ms */
#define INIT_WINDOW   0x0010 /* 10 ms */
#define CONN_INTERVAL 40     /* 50 ms */
#define CONN_LATENCY  0
#define CONN_TIMEOUT  MIN(MAX((CONN_INTERVAL * 125 * \
			       MAX(CONFIG_BT_MAX_CONN, 6) / 1000), 10), 3200)

//#define LOG_DISABLE 1

static const char adv_target_name[] = "Whack-A-Mole Button";
static bool 	  adv_target_name_found;

static void start_scan(void);
static void gatt_discover(struct bt_conn *conn, struct bt_nus_client *nus_client);

static app_bt_callback_t m_callback;

static struct bt_conn *conn_connecting;
static struct bt_conn_info conn_info;
static uint8_t volatile conn_count;
static bool volatile is_disconnecting;

static struct per_context_t {
	bool used;
	bool ready;
	struct bt_conn *conn;
	struct bt_nus_client nus_client;
	uint32_t index;
} per_context[CONFIG_BT_MAX_CONN] = {0};

static struct per_context_t *get_free_per_context(void)
{
	for(int i = 0; i < CONFIG_BT_MAX_CONN; i++) {
		if(!per_context[i].used) {
			per_context[i].used = true;
			return &per_context[i];
		}
	}
	return NULL;
}

static struct per_context_t *get_per_context_from_conn(struct bt_conn *conn)
{
	for(int i = 0; i < CONFIG_BT_MAX_CONN; i++) {
		if(per_context[i].used && per_context[i].conn == conn) {
			return &per_context[i];
		}
	}
	return NULL;
}

static struct per_context_t *get_per_context_from_client(struct bt_nus_client *client)
{
	for(int i = 0; i < CONFIG_BT_MAX_CONN; i++) {
		if(per_context[i].used && &per_context[i].nus_client == client) {
			return &per_context[i];
		}
	}
	return NULL;
}

static void fwd_event_con_num_change(uint32_t con_num)
{
	static struct app_bt_evt_t evt = {.type = APP_BT_EVT_CON_NUM_CHANGE};
	evt.num_connected = con_num;
	m_callback(&evt);
}

static void fwd_event_rx_data(uint32_t con_index, const uint8_t *data, uint16_t len)
{
	static struct app_bt_evt_t rx_evt = {.type = APP_BT_EVT_RX_DATA};
	rx_evt.con_index = con_index;
	rx_evt.data = data;
	rx_evt.data_len = len;
	m_callback(&rx_evt);
}

static void fwd_event_ctrl_link_con_discon(struct bt_conn *conn, bool connected)
{
	static struct app_bt_evt_t ctrl_con_discon_evt;
	ctrl_con_discon_evt.type = (connected ? APP_BT_EVT_CTRL_CONNECTED : APP_BT_EVT_CTRL_DISCONNECTED);
	ctrl_con_discon_evt.ctrl_conn = conn;
	m_callback(&ctrl_con_discon_evt);
}

static bool target_adv_name_found(struct bt_data *data, void *user_data)
{
	if (data->type == BT_DATA_NAME_COMPLETE) {
		//LOG_INF("Dev with name found: %.*s", data->data_len, data->data);
		if(memcmp(data->data, adv_target_name, strlen(adv_target_name)) == 0) {
			adv_target_name_found = true;
		}
		return false;
	}
	return true;
}

static void device_found(const bt_addr_le_t *addr, int8_t rssi, uint8_t type,
			 struct net_buf_simple *ad)
{
	struct bt_conn_le_create_param create_param = {
		.options = BT_CONN_LE_OPT_NONE,
		.interval = INIT_INTERVAL,
		.window = INIT_WINDOW,
		.interval_coded = 0,
		.window_coded = 0,
		.timeout = 0,
	};
	struct bt_le_conn_param conn_param = {
		.interval_min = CONN_INTERVAL,
		.interval_max = CONN_INTERVAL,
		.latency = CONN_LATENCY,
		.timeout = CONN_TIMEOUT,
	};
	char addr_str[BT_ADDR_LE_STR_LEN];
	int err;

	if (conn_connecting) {
		return;
	}

	/* We're only interested in connectable events */
	if (type != BT_GAP_ADV_TYPE_ADV_IND &&
	    type != BT_GAP_ADV_TYPE_ADV_DIRECT_IND &&
	    type != BT_GAP_ADV_TYPE_EXT_ADV) {
		return;
	}

	bt_addr_le_to_str(addr, addr_str, sizeof(addr_str));
	//LOG_INF("Device found: %s (RSSI %d)", addr_str, rssi);

	// Look for the target device name in the advertise payload, and return if it is not found
	adv_target_name_found = false;
	bt_data_parse(ad, target_adv_name_found, 0);
	if (!adv_target_name_found) {
		return;
	}

	if (bt_le_scan_stop()) {
		LOG_INF("Scanning successfully stopped");
		return;
	}

	err = bt_conn_le_create(addr, &create_param, &conn_param,
				&conn_connecting);
	if (err) {
		LOG_WRN("Create conn to %s failed (%d)", addr_str, err);
		start_scan();
	}
}

static void start_scan(void)
{
	struct bt_le_scan_param scan_param = {
		.type       = BT_HCI_LE_SCAN_PASSIVE,
		.options    = BT_LE_SCAN_OPT_NONE,
		.interval   = SCAN_INTERVAL,
		.window     = SCAN_WINDOW,
	};
	int err;

	err = bt_le_scan_start(&scan_param, device_found);
	if (err) {
		LOG_ERR("Scanning failed to start (err %d)", err);
		return;
	}

	LOG_INF("Scanning successfully started");
}

#if defined(CONFIG_BT_GATT_CLIENT)
static void mtu_exchange_cb(struct bt_conn *conn, uint8_t err,
			    struct bt_gatt_exchange_params *params)
{
	LOG_INF("MTU exchange %u %s (%u)", bt_conn_index(conn),
	       err == 0U ? "successful" : "failed", bt_gatt_get_mtu(conn));
	struct per_context_t *peripheral = get_per_context_from_conn(conn);
	gatt_discover(conn, &peripheral->nus_client);
}

static struct bt_gatt_exchange_params mtu_exchange_params[CONFIG_BT_MAX_CONN];

static int mtu_exchange(struct bt_conn *conn)
{
	uint8_t conn_index;
	int err;

	conn_index = bt_conn_index(conn);

	LOG_INF("MTU (%u): %u", conn_index, bt_gatt_get_mtu(conn));

	mtu_exchange_params[conn_index].func = mtu_exchange_cb;

	err = bt_gatt_exchange_mtu(conn, &mtu_exchange_params[conn_index]);
	if (err) {
		LOG_ERR("MTU exchange failed (err %d)", err);
	} else {
		LOG_DBG("Exchange pending...");
	}

	return err;
}
#endif /* CONFIG_BT_GATT_CLIENT */

static void discovery_complete(struct bt_gatt_dm *dm,
			       void *context)
{
	struct bt_nus_client *nus = context;

	LOG_INF("Service discovery completed");

	bt_gatt_dm_data_print(dm);

	bt_nus_handles_assign(dm, nus);
	bt_nus_subscribe_receive(nus);

	bt_gatt_dm_data_release(dm);

	start_scan();

	struct per_context_t *peripheral = get_per_context_from_client(nus);
	if (peripheral) {
		peripheral->ready = true;
		fwd_event_con_num_change(conn_count);
	}
}

static void discovery_service_not_found(struct bt_conn *conn,
					void *context)
{
	LOG_WRN("Service not found!");
}

static void discovery_error(struct bt_conn *conn,
			    int err,
			    void *context)
{
	LOG_ERR("Error while discovering GATT database: (%d)", err);
}

struct bt_gatt_dm_cb discovery_cb = {
	.completed         = discovery_complete,
	.service_not_found = discovery_service_not_found,
	.error_found       = discovery_error,
};

static void gatt_discover(struct bt_conn *conn, struct bt_nus_client *nus_client)
{
	int err;

	/*if (conn != default_conn) {
		return;
	}*/

	err = bt_gatt_dm_start(conn,
			       BT_UUID_NUS_SERVICE,
			       &discovery_cb,
			       nus_client);
	if (err) {
		LOG_ERR("could not start the discovery procedure, error code: %d", err);
		start_scan();
	}
}

static void connected(struct bt_conn *conn, uint8_t reason)
{
	char addr[BT_ADDR_LE_STR_LEN];

	bt_conn_get_info(conn, &conn_info);
	// One of the peripherals/thingy's connected
	if (conn_info.role == BT_CONN_ROLE_CENTRAL) {
		bt_addr_le_to_str(bt_conn_get_dst(conn), addr, sizeof(addr));

		if (reason) {
			LOG_ERR("Failed to connect to %s (%u)", addr, reason);

			bt_conn_unref(conn_connecting);
			conn_connecting = NULL;

			start_scan();
			return;
		}

		conn_connecting = NULL;

		conn_count++;
		
		if (conn_count < CONFIG_BT_MAX_CONN) {
			//start_scan(); // Try to skip this, in order to speed up the connection procedure
		}

		struct per_context_t *peripheral = get_free_per_context();
		if (peripheral) {
			peripheral->conn = conn;
			peripheral->ready = false;
		}

		LOG_DBG("Connected (%u): %s", conn_count, addr);

#if defined(CONFIG_BT_SMP)
		int err = bt_conn_set_security(conn, BT_SECURITY_L2);

		if (err) {
			LOG_ERR("Failed to set security (%d).", err);
		}
#endif

#if defined(CONFIG_BT_GATT_CLIENT)
		mtu_exchange(conn);
#endif
	}
	// The central/phone connected
	else {
		fwd_event_ctrl_link_con_discon(conn, true);
	}
}

static void disconnected(struct bt_conn *conn, uint8_t reason)
{
	char addr[BT_ADDR_LE_STR_LEN];

	bt_conn_get_info(conn, &conn_info);

	// One of the peripherals/thingy's disconnected
	if (conn_info.role == BT_CONN_ROLE_CENTRAL) {
		bt_addr_le_to_str(bt_conn_get_dst(conn), addr, sizeof(addr));

		bt_conn_unref(conn);

		struct per_context_t *peripheral = get_per_context_from_conn(conn);
		if (peripheral) {
			peripheral->used = false;
		} 

		if ((conn_count == 1U) && is_disconnecting) {
			is_disconnecting = false;
			start_scan();
		}
		conn_count--;

		LOG_INF("Disconnected (count %i): %s (reason 0x%02x)", conn_count, addr, reason);

		fwd_event_con_num_change(conn_count);
	}
	// The central (phone) disconnected
	else {
		fwd_event_ctrl_link_con_discon(conn, false);
	}
}

static bool le_param_req(struct bt_conn *conn, struct bt_le_conn_param *param)
{
	char addr[BT_ADDR_LE_STR_LEN];

	bt_addr_le_to_str(bt_conn_get_dst(conn), addr, sizeof(addr));

	LOG_DBG("LE conn param req: %s int (0x%04x, 0x%04x) lat %d to %d",
	       addr, param->interval_min, param->interval_max, param->latency,
	       param->timeout);

	return true;
}

static void le_param_updated(struct bt_conn *conn, uint16_t interval,
			     uint16_t latency, uint16_t timeout)
{
	char addr[BT_ADDR_LE_STR_LEN];

	bt_addr_le_to_str(bt_conn_get_dst(conn), addr, sizeof(addr));

	LOG_DBG("LE conn param updated: %s int 0x%04x lat %d to %d",
	       addr, interval, latency, timeout);
}

#if defined(CONFIG_BT_SMP)
static void security_changed(struct bt_conn *conn, bt_security_t level,
			     enum bt_security_err err)
{
	char addr[BT_ADDR_LE_STR_LEN];

	bt_addr_le_to_str(bt_conn_get_dst(conn), addr, sizeof(addr));

	if (!err) {
		LOG_INF("Security changed: %s level %u", addr, level);
	} else {
		LOG_ERR("Security failed: %s level %u err %d", addr, level,
		       err);
	}
}
#endif

#if defined(CONFIG_BT_USER_PHY_UPDATE)
static void le_phy_updated(struct bt_conn *conn,
			   struct bt_conn_le_phy_info *param)
{
	char addr[BT_ADDR_LE_STR_LEN];

	bt_addr_le_to_str(bt_conn_get_dst(conn), addr, sizeof(addr));

	LOG_INF("LE PHY Updated: %s Tx 0x%x, Rx 0x%x", addr, param->tx_phy,
	       param->rx_phy);
}
#endif /* CONFIG_BT_USER_PHY_UPDATE */

#if defined(CONFIG_BT_USER_DATA_LEN_UPDATE)
static void le_data_len_updated(struct bt_conn *conn,
				struct bt_conn_le_data_len_info *info)
{
	char addr[BT_ADDR_LE_STR_LEN];

	bt_addr_le_to_str(bt_conn_get_dst(conn), addr, sizeof(addr));

	LOG_INF("Data length updated: %s max tx %u (%u us) max rx %u (%u us)",
	       addr, info->tx_max_len, info->tx_max_time, info->rx_max_len,
	       info->rx_max_time);
}
#endif /* CONFIG_BT_USER_DATA_LEN_UPDATE */

static struct bt_conn_cb conn_callbacks = {
	.connected = connected,
	.disconnected = disconnected,
	.le_param_req = le_param_req,
	.le_param_updated = le_param_updated,

#if defined(CONFIG_BT_SMP)
	.security_changed = security_changed,
#endif

#if defined(CONFIG_BT_USER_PHY_UPDATE)
	.le_phy_updated = le_phy_updated,
#endif /* CONFIG_BT_USER_PHY_UPDATE */

#if defined(CONFIG_BT_USER_DATA_LEN_UPDATE)
	.le_data_len_updated = le_data_len_updated,
#endif /* CONFIG_BT_USER_DATA_LEN_UPDATE */
};

static void disconnect(struct bt_conn *conn, void *data)
{
	char addr[BT_ADDR_LE_STR_LEN];
	int err;

	bt_addr_le_to_str(bt_conn_get_dst(conn), addr, sizeof(addr));

	err = bt_conn_disconnect(conn, BT_HCI_ERR_REMOTE_USER_TERM_CONN);
	if (err) {
		LOG_ERR("Failed disconnection %s.", addr);
	}
	else {
		LOG_DBG("Disconnecting %s... success.", addr);
	}
}

static uint8_t nus_data_received(struct bt_nus_client *nus, const uint8_t *data, uint16_t len)
{
	struct per_context_t *peripheral = get_per_context_from_client(nus);
	LOG_INF("BT RX (con ind %i): %.*s", peripheral->index, len, data);
	fwd_event_rx_data(peripheral->index, data, len);
	return BT_GATT_ITER_CONTINUE;
}
static volatile int packets_queued = 0;
static void nus_data_sent(struct bt_nus_client *nus, uint8_t err, const uint8_t *const data, uint16_t len)
{
	packets_queued--;
}

int app_bt_init(app_bt_callback_t callback)
{
	int err;

	err = bt_enable(NULL);
	if (err) {
		LOG_ERR("Bluetooth init failed (err %d)", err);
		return err;
	}

	m_callback = callback;

	LOG_INF("Bluetooth initialized");

	struct bt_nus_client_init_param init = {
		.cb = {
			.received = nus_data_received,
			.sent = nus_data_sent,
		}
	};

	for(int i = 0; i < CONFIG_BT_MAX_CONN; i++) {
		per_context[i].index = i;
		err = bt_nus_client_init(&(per_context[i].nus_client), &init);
		if (err) {
			LOG_ERR("NUS Client initialization failed (err %d)", err);
			return err;
		}
	}

	bt_conn_cb_register(&conn_callbacks);

	start_scan();

	return 0;
}

int app_bt_send_str(uint32_t con_index, const uint8_t *string, uint16_t len)
{
	int ret;
	if (con_index >= CONFIG_BT_MAX_CONN) {
		return -EINVAL;
	}
	if (per_context[con_index].ready) {
		ret = bt_nus_client_send(&(per_context[con_index].nus_client), string, len);
		if (ret < 0) {
			LOG_ERR("ERROR sending to client %i: %i. PQ %i", con_index, ret, packets_queued);
			return ret;
		}
		packets_queued++;
	}
	else return -EBUSY;
	return 0;
}

void app_bt_disconnect_all(void)
{
	LOG_DBG("Disconnecting all...");
	is_disconnecting = true;
	bt_conn_foreach(BT_CONN_TYPE_LE, disconnect, NULL);

	while (is_disconnecting) {
		k_sleep(K_MSEC(10));
	}
	LOG_DBG("All disconnected.");
}
```

## src/app_bt.h
```c
#ifndef __APP_BT_H
#define __APP_BT_H

#include <zephyr/kernel.h>
#include <zephyr/bluetooth/conn.h>
#include <color.h>

enum {APP_BT_EVT_CON_NUM_CHANGE, APP_BT_EVT_RX_DATA, APP_BT_EVT_CTRL_CONNECTED, APP_BT_EVT_CTRL_DISCONNECTED};

struct app_bt_evt_t {
    uint32_t type;
    uint32_t num_connected;
    const uint8_t *data;
    uint16_t data_len;
    uint32_t con_index;
	struct bt_conn *ctrl_conn;
};

typedef void (*app_bt_callback_t)(struct app_bt_evt_t *event);

int app_bt_init(app_bt_callback_t callback);

int app_bt_send_str(uint32_t con_index, const uint8_t *string, uint16_t len);

#endif
```

## src/app_bt_ctrl.c
```c
#include <app_bt_ctrl.h>
#include <zephyr/types.h>
#include <zephyr/bluetooth/bluetooth.h>
#include <zephyr/bluetooth/uuid.h>
#include <zephyr/bluetooth/gatt.h>
#include <zephyr/bluetooth/hci.h>
#include <bluetooth/services/nus.h>

#include <zephyr/logging/log.h>

#define LOG_MODULE_NAME app_bt_ctrl
LOG_MODULE_REGISTER(LOG_MODULE_NAME, LOG_LEVEL_DBG);

#define DEVICE_NAME CONFIG_BT_DEVICE_NAME
#define DEVICE_NAME_LEN	(sizeof(DEVICE_NAME) - 1)

static const struct bt_data ad[] = {
	BT_DATA_BYTES(BT_DATA_FLAGS, (BT_LE_AD_GENERAL | BT_LE_AD_NO_BREDR)),
	BT_DATA(BT_DATA_NAME_COMPLETE, DEVICE_NAME, DEVICE_NAME_LEN),
};

static const struct bt_data sd[] = {
	BT_DATA_BYTES(BT_DATA_UUID128_ALL, BT_UUID_NUS_VAL),
};

static struct bt_conn *current_conn = 0;

static void bt_receive_cb(struct bt_conn *conn, const uint8_t *const data,
			  uint16_t len)
{
	LOG_INF("CTRL data received, %i bytes", len);
}

static struct bt_nus_cb nus_cb = {
	.received = bt_receive_cb,
};

int app_bt_ctrl_connected(struct bt_conn *conn)
{
	LOG_INF("Connected!");
	current_conn = conn;
	return 0;
}

int app_bt_ctrl_disconnected(struct bt_conn *conn)
{
	LOG_INF("Disconnected!");
	current_conn = 0;
	return 0;
}

int app_bt_ctrl_init(app_bt_ctrl_callback_t callback)
{
	int err = bt_nus_init(&nus_cb);
	if (err) {
		LOG_ERR("Failed to initialize UART service (err: %d)", err);
		return err;
	}

	err = bt_le_adv_start(BT_LE_ADV_CONN, ad, ARRAY_SIZE(ad), sd,
			      ARRAY_SIZE(sd));
	if (err) {
		LOG_ERR("Advertising failed to start (err %d)", err);
		return err;
	}

	LOG_DBG("App BT Peripheral initialized");

	return 0;
}

int app_bt_ctrl_send_str(const uint8_t *string, uint16_t len)
{	
	int err;
	if (current_conn == 0) {
		LOG_WRN("No controller connected. Ignoring peripheral TX");
		return -ENOTCONN;
	}
	err = bt_nus_send(current_conn, string, len); 
	if (err < 0) {
		LOG_WRN("Failed to send data over BLE connection");
		return err;
	}
	return 0;
}
```

## src/app_bt_ctrl.h
```c
#ifndef __APP_BT_CTRL_H
#define __APP_BT_CTRL_H

#include <zephyr/kernel.h>
#include <zephyr/bluetooth/conn.h>

enum {APP_BT_CTRL_EVT_RX_DATA};

struct app_bt_ctrl_evt_t {
    uint32_t type;
    const uint8_t *data;
    uint16_t data_len;
};

typedef void (*app_bt_ctrl_callback_t)(struct app_bt_ctrl_evt_t *event);

int app_bt_ctrl_connected(struct bt_conn *conn);

int app_bt_ctrl_disconnected(struct bt_conn *conn);

int app_bt_ctrl_init(app_bt_ctrl_callback_t callback);

int app_bt_ctrl_send_str(const uint8_t *string, uint16_t len);

#endif
```

## src/app_bt_per.c
```c
#include <app_bt_per.h>
#include <zephyr/types.h>
#include <zephyr/bluetooth/bluetooth.h>
#include <zephyr/bluetooth/uuid.h>
#include <zephyr/bluetooth/gatt.h>
#include <zephyr/bluetooth/hci.h>
#include <bluetooth/services/nus.h>

#include <zephyr/logging/log.h>

#define LOG_MODULE_NAME app_bt_per
LOG_MODULE_REGISTER(LOG_MODULE_NAME, LOG_LEVEL_DBG);

#define DEVICE_NAME CONFIG_BT_DEVICE_NAME
#define DEVICE_NAME_LEN	(sizeof(DEVICE_NAME) - 1)

static const struct bt_data ad[] = {
	BT_DATA_BYTES(BT_DATA_FLAGS, (BT_LE_AD_GENERAL | BT_LE_AD_NO_BREDR)),
	BT_DATA(BT_DATA_NAME_COMPLETE, DEVICE_NAME, DEVICE_NAME_LEN),
};

static const struct bt_data sd[] = {
	BT_DATA_BYTES(BT_DATA_UUID128_ALL, BT_UUID_NUS_VAL),
};

static struct bt_conn *current_conn = 0;

static void bt_receive_cb(struct bt_conn *conn, const uint8_t *const data,
			  uint16_t len)
{
	LOG_DBG("Data received, %i bytes", len);
}

static struct bt_nus_cb nus_cb = {
	.received = bt_receive_cb,
};

int app_bt_per_connected(struct bt_conn *conn)
{
	LOG_INF("Connected!");
	current_conn = conn;
	return 0;
}

int app_bt_per_disconnected(struct bt_conn *conn)
{
	LOG_INF("Disconnected!");
	current_conn = 0;
	return 0;
}

int app_bt_per_init(app_bt_per_callback_t callback)
{
	int err = bt_nus_init(&nus_cb);
	if (err) {
		LOG_ERR("Failed to initialize UART service (err: %d)", err);
		return err;
	}

	err = bt_le_adv_start(BT_LE_ADV_CONN, ad, ARRAY_SIZE(ad), sd,
			      ARRAY_SIZE(sd));
	if (err) {
		LOG_ERR("Advertising failed to start (err %d)", err);
		return err;
	}

	LOG_DBG("App BT Peripheral initialized");

	return 0;
}

int app_bt_per_send_str(const uint8_t *string, uint16_t len)
{	
	int err;
	if (current_conn == 0) {
		LOG_WRN("No peripheral connected. Ignoring peripheral TX");
		return -ENOTCONN;
	}
	err = bt_nus_send(current_conn, string, len); 
	if (err < 0) {
		LOG_WRN("Failed to send data over BLE connection");
		return err;
	}
	return 0;
}
```

## src/app_bt_per.h
```c
#ifndef __APP_BT_PER_H
#define __APP_BT_PER_H

#include <zephyr/kernel.h>
#include <zephyr/bluetooth/conn.h>

enum {APP_BT_PER_EVT_RX_DATA};

struct app_bt_per_evt_t {
    uint32_t type;
    const uint8_t *data;
    uint16_t data_len;
};

typedef void (*app_bt_per_callback_t)(struct app_bt_per_evt_t *event);

int app_bt_per_connected(struct bt_conn *conn);

int app_bt_per_disconnected(struct bt_conn *conn);

int app_bt_per_init(app_bt_per_callback_t callback);

int app_bt_per_send_str(const uint8_t *string, uint16_t len);

#endif
```

## src/game.h
```c
#ifndef __GAME_H
#define __GAME_H

#include <zephyr/kernel.h>
#include <app_bt.h>

struct game_t;

typedef void (*game_func_bt_send_t)(uint32_t con_index, const uint8_t *data, uint16_t len);
typedef void (*game_func_bt_ctrl_send_t)(const uint8_t *data, uint16_t len);
typedef void (*game_func_play_t)(struct game_t *game);
typedef void (*game_func_bt_evt_t)(struct game_t *game, struct app_bt_evt_t *bt_evt);

struct game_t {
    game_func_play_t play;
    game_func_bt_evt_t bt_rx;
    game_func_bt_send_t bt_send;
	game_func_bt_ctrl_send_t bt_ctrl_send;
};

#endif
```

## src/game_whackamole.c
```c
#include <game.h>
#include <string.h>
#include <stdlib.h>

#define CHALLENGE_NUM_MAX 32

#define COLOR_PLAYER1       0x33FF11
#define COLOR_PLAYER2       0x1166FF

K_SEM_DEFINE(m_sem_num_players_update, 0, 1);
K_SEM_DEFINE(m_sem_peripheral_update, 0, 1);
K_SEM_DEFINE(m_sem_second_tick, 0, 1);

int num_players;
bool ping_received;


const led_effect_cfg_t led_effect_p1_select = {.color1 = COLOR_PLAYER1, .color2 = LED_COLOR_BLACK, .color_end = LED_COLOR_BLACK,
                                               .speed = 12, .num_repeats = LED_REPEAT_INFINITE};
const led_effect_cfg_t led_effect_p2_select = {.color1 = COLOR_PLAYER2, .color2 = LED_COLOR_BLACK, .color_end = LED_COLOR_BLACK,
                                               .speed = 12, .num_repeats = LED_REPEAT_INFINITE};
const led_effect_cfg_t led_effect_challenge = {.color1 = LED_COLOR_PURPLE, .color2 = LED_COLOR_ORANGE, .color_end = LED_COLOR_BLACK,
                                               .speed = 45, .num_repeats = LED_REPEAT_INFINITE};
const led_effect_cfg_t led_effect_result_good = {.color1 = LED_COLOR_GREEN, .color2 = LED_COLOR_BLACK, .color_end = LED_COLOR_BLACK,
                                               .speed = 60, .num_repeats = 4};
const led_effect_cfg_t led_effect_result_bad = {.color1 = LED_COLOR_RED, .color2 = LED_COLOR_BLACK, .color_end = LED_COLOR_BLACK,
                                               .speed = 60, .num_repeats = 4};
const led_effect_cfg_t led_effect_result_win  = {.color1 = LED_COLOR_GREEN, .color2 = LED_COLOR_BLACK, .color_end = LED_COLOR_BLACK,
                                               .speed = 30, .num_repeats = LED_REPEAT_INFINITE};
const led_effect_cfg_t led_effect_result_lose = {.color1 = LED_COLOR_RED, .color2 = LED_COLOR_BLACK, .color_end = LED_COLOR_BLACK,
                                               .speed = 8, .num_repeats = LED_REPEAT_INFINITE};

struct whackamole_t {
    int round_duration_s;
    int time;
    int challenge_int_min, challenge_int_range;
    int chg_rsp_total, chg_rsp_counter;
} whackamole;

struct player_t {
    uint32_t per_index;
    uint32_t per_num;
    bool player_ping_received;
    int time_until_challenge;
    uint32_t challenge_response_time_list[CHALLENGE_NUM_MAX];
    uint32_t challenge_counter;
    uint32_t challenge_average;
} player[2];

void game_timer_func(struct k_timer *timer_id); 

K_TIMER_DEFINE(m_timer_game, game_timer_func, NULL);

enum {PER_INDEX_ALL = 0x1000, PER_INDEX_ALL_P1, PER_INDEX_ALL_P2};

static void send_color_effect(struct game_t *game, uint32_t per_index, uint8_t sub_cmd, const led_effect_cfg_t *effect)
{
    static uint8_t led_effect_cmd[LED_EFFECT_CMD_SIZE];
    led_effect_to_cmd(effect, sub_cmd, led_effect_cmd);
    if(per_index == PER_INDEX_ALL_P1) {
        for(int i = 0; i < player[0].per_num; i++) {
            game->bt_send(player[0].per_index + i, led_effect_cmd, LED_EFFECT_CMD_SIZE);
        }
    }
    else if(per_index == PER_INDEX_ALL_P2) {
        for(int i = 0; i < player[1].per_num; i++) {
            game->bt_send(player[1].per_index + i, led_effect_cmd, LED_EFFECT_CMD_SIZE);
        }
    }
    else if(per_index == PER_INDEX_ALL) {
         for(int i = 0; i < (player[0].per_num + player[1].per_num); i++) {
            game->bt_send(i, led_effect_cmd, LED_EFFECT_CMD_SIZE);
        }       
    }
    else {
        game->bt_send(per_index, led_effect_cmd, LED_EFFECT_CMD_SIZE);
    }
}

void whackamole_bt_rx(struct game_t *game, struct app_bt_evt_t *bt_evt)
{
    int player_index = (bt_evt->con_index < player[1].per_index) ? 0 : 1;
    switch(bt_evt->type) {
        case APP_BT_EVT_CON_NUM_CHANGE:
            num_players = bt_evt->num_connected;
            k_sem_give(&m_sem_num_players_update); 
            break;
        case APP_BT_EVT_RX_DATA:
            if (memcmp(bt_evt->data, "PING", 4) == 0) {
                ping_received = true;
                player[player_index].player_ping_received = true;
            }
            else if (memcmp(bt_evt->data, "TD:", 3) == 0 && bt_evt->data_len >= 9) {
                uint32_t response_time = 0;
                for(int i = 0; i < 6; i++) {
                    response_time = response_time * 10 + (bt_evt->data[i+3] - '0');
                }
                if (player[player_index].challenge_counter < CHALLENGE_NUM_MAX) {
                    player[player_index].challenge_response_time_list[player[player_index].challenge_counter++] = response_time;

                    whackamole.chg_rsp_total += response_time;
                    whackamole.chg_rsp_counter++;
                    if(whackamole.chg_rsp_counter == 1 || (whackamole.chg_rsp_total / whackamole.chg_rsp_counter) > response_time) {
                        send_color_effect(game, PER_INDEX_ALL_P1 + player_index, '0', &led_effect_result_good);
                    }
                    else {
                        send_color_effect(game, PER_INDEX_ALL_P1 + player_index, '0', &led_effect_result_bad);
                    }
                }
            }
            k_sem_give(&m_sem_peripheral_update);
            break;
    }
}

static void whackamole_play(struct game_t *game)
{
    printk("Welcome to Whack-A-Mole. The most exiting game in the world!!!\n");
    printk("Waiting for peripherals to connect...\n");
    
    whackamole.round_duration_s = 60;
    whackamole.time = 0;
    whackamole.challenge_int_min = 2;
    whackamole.challenge_int_range = 10;
    whackamole.chg_rsp_total = whackamole.chg_rsp_counter = 0;

    // Waiting for players to connect
    ping_received = false;
    while (num_players < 2 || !ping_received) {
        if (k_sem_take(&m_sem_num_players_update, K_MSEC(100)) == 0) {
            printk("Controllers connected: %i\n", num_players);
        }
    }

    // Signalling to players which each peripheral belongs to
    printk("Sufficient controllers connected. Proceeding to team selection...\n");
    for(int p = 0; p < 2; p++) {
        player[p].per_num = num_players / 2;
        player[p].per_index = p * (num_players / 2);
        player[p].player_ping_received = false;
        player[p].time_until_challenge = 0;
        player[p].challenge_counter = 0;
    }
    player[0].player_ping_received = player[1].player_ping_received = false;

    send_color_effect(game, PER_INDEX_ALL_P1, '0', &led_effect_p1_select);
    send_color_effect(game, PER_INDEX_ALL_P2, '0', &led_effect_p2_select);

    // Waiting for confirmation to proceed from both players
    while (!(player[0].player_ping_received && player[1].player_ping_received)) {
        k_sem_take(&m_sem_peripheral_update, K_FOREVER);
    }

    // Use the uptime to provide a semi random seed to the random generator
    srand(k_uptime_get_32());

    printk("Sending reset command to all peripherals\n");
    for(int i = 0; i < (player[0].per_num + player[1].per_num); i++) {
        game->bt_send(i, "RST", 3);
    }

    // Starting first round
    k_timer_start(&m_timer_game, K_SECONDS(1), K_SECONDS(1));

    while (whackamole.time < whackamole.round_duration_s) {
        k_sem_take(&m_sem_second_tick, K_FOREVER);
    
        // Waiting for a random time and triggering an update on a random peripheral for each team
        for (int p = 0; p < 2; p++) {
            if (player[p].time_until_challenge == 0) {
                player[p].time_until_challenge = whackamole.challenge_int_min + rand() % whackamole.challenge_int_range;
                printk("Player %i: Challenge in %i seconds\n", p, player[p].time_until_challenge);
            }
            else {
                player[p].time_until_challenge--;
                if (player[p].time_until_challenge == 0) {
                    int random_peripheral_index = player[p].per_index + rand()%player[p].per_num;
                    send_color_effect(game, random_peripheral_index, '1', &led_effect_challenge);
                }
            }
        }
    }

    // Print an end of round report
    printk("Round complete!\n");
    k_timer_stop(&m_timer_game);
    for (int p = 0; p < 2; p++) {
        int result, min = 1000000000, max = 0, total = 0;
        if (player[p].challenge_counter > 0) {
            printk("\nResults player %i: \n", p);
            for (int i = 0; i < player[p].challenge_counter; i++) {
                result = player[p].challenge_response_time_list[i];
                printk("  Challenge %i: Time %i ms\n", (i+1), result);
                if (result < min) min = result;
                if (result > max) max = result;
                total += result; 
            }
            printk("  Best result:  %i ms\n", min);
            printk("  Worst result: %i ms\n", max);
            player[p].challenge_average = total / player[p].challenge_counter;
            printk("  Average:      %i ms\n", player[p].challenge_average);
        }
        else {
            printk("\nNo results for player %i\n",p);
        }
    }

    // Show which player has won by making the peripherals go green or red
    if (player[0].challenge_average < player[1].challenge_average) {
        // Player 0 won!
        send_color_effect(game, PER_INDEX_ALL_P1, '0', &led_effect_result_win);
        send_color_effect(game, PER_INDEX_ALL_P2, '0', &led_effect_result_lose);
    }
    else {
        // Player 1 won!
        send_color_effect(game, PER_INDEX_ALL_P1, '0', &led_effect_result_lose);
        send_color_effect(game, PER_INDEX_ALL_P2, '0', &led_effect_result_win);
    }
}

void game_timer_func(struct k_timer *timer_id)
{
    whackamole.time++;
    k_sem_give(&m_sem_second_tick);
}

int whackamole_init(struct game_t *game)
{
    game->play = whackamole_play;
    game->bt_rx = whackamole_bt_rx;
    num_players = 0;

    return 0;
}
```

## src/game_whackamole.h
```c
#ifndef __GAME_WHACKAMOLE_H
#define __GAME_WHACKAMOLE_H

#include <game.h>

int whackamole_init(struct game_t *game);

#endif
```

## src/game_whackamole_1p.c
```c
#include <game.h>
#include <string.h>
#include <stdlib.h>

#define CHALLENGE_NUM_MAX 256
#define MAX_ROUNDS		  6
#define PERIPHERALS_MAX	  8

K_SEM_DEFINE(m_sem_num_players_update, 0, 1);
K_SEM_DEFINE(m_sem_peripheral_update, 0, 1);
K_SEM_DEFINE(m_sem_second_tick, 0, 1);

struct game_t *this;

int num_players;
bool ping_received;

const led_effect_cfg_t led_effect_challenge = {.color1 = LED_COLOR_PURPLE, .color2 = LED_COLOR_ORANGE, .color_end = LED_COLOR_BLACK,
                                               .speed = 45, .num_repeats = LED_REPEAT_INFINITE};
const led_effect_cfg_t led_effect_result_good = {.color1 = LED_COLOR_GREEN, .color2 = LED_COLOR_BLACK, .color_end = LED_COLOR_BLACK,
                                               .speed = 60, .num_repeats = 3};
const led_effect_cfg_t led_effect_result_bad = {.color1 = LED_COLOR_RED, .color2 = LED_COLOR_BLACK, .color_end = LED_COLOR_BLACK,
                                               .speed = 60, .num_repeats = 3};
const led_effect_cfg_t led_effect_result_win  = {.color1 = LED_COLOR_GREEN, .color2 = LED_COLOR_BLACK, .color_end = LED_COLOR_BLACK,
                                               .speed = 30, .num_repeats = LED_REPEAT_INFINITE};
const led_effect_cfg_t led_effect_result_lose = {.color1 = LED_COLOR_RED, .color2 = LED_COLOR_BLACK, .color_end = LED_COLOR_BLACK,
                                               .speed = 8, .num_repeats = LED_REPEAT_INFINITE};
const led_effect_cfg_t led_effect_new_round   = {.color1 = LED_COLOR_BLACK, .color2 = LED_COLOR_WHITE, .color_end = LED_COLOR_BLACK,
                                               .speed = 30, .num_repeats = 2};

struct whackamole_t {
    int round_duration_s;
	int number_of_rounds;
	int current_round;
	int challenges_pr_round;
	int challenge_index;
	int target_pr_round[MAX_ROUNDS];
    int time, time_until_challenge;
    int challenge_int_min, challenge_int_range;
    int chg_rsp_total, chg_rsp_counter;
	bool game_running;
} whackamole;

struct player_t {
    uint32_t per_index;
    uint32_t per_num;
	int chg_per_index, chg_per_index_previous;
    bool player_ping_received;
    int time_until_challenge;
	int score;
	int missing_scores;
	int fouls;
    uint32_t challenge_response_time_list[CHALLENGE_NUM_MAX];
    uint32_t challenge_counter;
    uint32_t challenge_average;
	int challenge_queued_by_peripheral[PERIPHERALS_MAX];
} player[1];

void game_timer_func(struct k_timer *timer_id); 

K_TIMER_DEFINE(m_timer_game, game_timer_func, NULL);

enum {PER_INDEX_ALL = 0x1000, PER_INDEX_ALL_P1, PER_INDEX_ALL_P2};

static void send_color_effect(uint32_t per_index, uint8_t sub_cmd, const led_effect_cfg_t *effect, uint16_t timeout)
{
    static uint8_t led_effect_cmd[LED_EFFECT_CMD_SIZE];
    led_effect_to_cmd_to(effect, sub_cmd, led_effect_cmd, timeout);
	if(per_index == PER_INDEX_ALL) {
         for(int i = 0; i < player[0].per_num; i++) {
            this->bt_send(i, led_effect_cmd, LED_EFFECT_CMD_SIZE);
			//k_msleep(2);
        }       
    }
    else {
        this->bt_send(per_index, led_effect_cmd, LED_EFFECT_CMD_SIZE);
    }
}

static uint8_t per_cmd_buf[20];
static void send_per_cmd_chg_start(uint8_t p_index, uint16_t target_time)
{
	int i = 0;
	per_cmd_buf[i++] = 'A';
	per_cmd_buf[i++] = p_index;
	per_cmd_buf[i++] = (uint8_t)num_players;
	per_cmd_buf[i++] = (uint8_t)(target_time >> 8);
	per_cmd_buf[i++] = (uint8_t)target_time;
	this->bt_ctrl_send(per_cmd_buf, i);
}

static void send_per_cmd_chg_finish(uint8_t p_index, uint16_t time, uint16_t target, bool success, uint16_t points, uint16_t fouls)
{
	int i = 0;
	per_cmd_buf[i++] = 'B';
	per_cmd_buf[i++] = p_index;
	per_cmd_buf[i++] = (uint8_t)(time >> 8);
	per_cmd_buf[i++] = (uint8_t)time;
	per_cmd_buf[i++] = (uint8_t)(target >> 8);
	per_cmd_buf[i++] = (uint8_t)target;
	per_cmd_buf[i++] = success ? 1 : 0;
	per_cmd_buf[i++] = (uint8_t)(points >> 8);
	per_cmd_buf[i++] = (uint8_t)points;
	per_cmd_buf[i++] = (uint8_t)(fouls >> 8);
	per_cmd_buf[i++] = (uint8_t)fouls;
	this->bt_ctrl_send(per_cmd_buf, i);
}

static void send_per_cmd_round_start(int round_index, int round_total, int target_time)
{
	int i = 0;
	per_cmd_buf[i++] = 'C';
	per_cmd_buf[i++] = (uint8_t)round_index;
	per_cmd_buf[i++] = (uint8_t)round_total;
	per_cmd_buf[i++] = (uint8_t)num_players;
	per_cmd_buf[i++] = (uint8_t)(target_time >> 8);
	per_cmd_buf[i++] = (uint8_t)target_time;
	this->bt_ctrl_send(per_cmd_buf, i);
}

static void send_per_cmd_game_start()
{
	int i = 0;
	per_cmd_buf[i++] = 'D';
	this->bt_ctrl_send(per_cmd_buf, i);
}

static void send_per_cmd_game_finish(int score, int min, int max, int average)
{
	int i = 0;
	per_cmd_buf[i++] = 'E';
	per_cmd_buf[i++] = (uint8_t)(score >> 8);
	per_cmd_buf[i++] = (uint8_t)score;
	per_cmd_buf[i++] = (uint8_t)(min >> 8);
	per_cmd_buf[i++] = (uint8_t)min;
	per_cmd_buf[i++] = (uint8_t)(max >> 8);
	per_cmd_buf[i++] = (uint8_t)max;
	per_cmd_buf[i++] = (uint8_t)(average >> 8);
	per_cmd_buf[i++] = (uint8_t)average;
	this->bt_ctrl_send(per_cmd_buf, i);
}

static void send_per_cmd_num_con_change(int num_con)
{
	int i = 0;
	per_cmd_buf[i++] = 'F';
	per_cmd_buf[i++] = (uint8_t)num_con;
	this->bt_ctrl_send(per_cmd_buf, i);
}

#define CONSOLE_SCORE_PROGRESS_COL 50
static int console_print_progress = -1;
static int console_print_goal_line_index;
static bool challenge_pending = false;
static int foul_presses = 0;

void challenge_finalize(uint32_t time, uint32_t target_time, bool success, int pad_lines)
{
 	if(success) {
		// Response time sufficient, award one point
		player[0].score++;
		if(foul_presses > 0) {
			player[0].score -= foul_presses;
			player[0].fouls += foul_presses;
		}
		printk("+");
		int goal_line_tmp_index = pad_lines + console_print_goal_line_index - CONSOLE_SCORE_PROGRESS_COL - 1;
		for(int i = 0; i < pad_lines; i++) (i == goal_line_tmp_index) ? printk("|") : printk(" ");
		printk("+1 point. Score %i. Time %i ms\n", player[0].score, time);
		send_color_effect(PER_INDEX_ALL, '0', &led_effect_result_good, 0);
		send_per_cmd_chg_finish(0, (uint16_t)time, target_time, true, 1, foul_presses);
	}
	else {
		// Too slow, no points awarded
		printk("X");
		for(int i = 0; i < pad_lines; i++) printk(" ");
		if(foul_presses > 0) {
			player[0].score -= foul_presses;
			player[0].fouls += foul_presses;
			printk("Fouls: %i. Score %i", foul_presses, player[0].score);
		}
		else {
			printk("-");
		}
		printk("\n");
		send_color_effect(PER_INDEX_ALL, '0', &led_effect_result_bad, 0);
		send_per_cmd_chg_finish(0, (uint16_t)time, target_time, false, 0, foul_presses);
	}
	foul_presses = 0;
}

void whackamole_bt_rx(struct game_t *game, struct app_bt_evt_t *bt_evt)
{
	static uint32_t last_chg_response_time;
    switch(bt_evt->type) {
        case APP_BT_EVT_CON_NUM_CHANGE:
            num_players = bt_evt->num_connected;
            k_sem_give(&m_sem_num_players_update); 
            break;
        case APP_BT_EVT_RX_DATA:
            if (memcmp(bt_evt->data, "PING", 4) == 0) {
				ping_received = true;
				if(whackamole.game_running) {
					// If a ping happens very quickly after a valid response, assume it was a dummy double click and not the players fault
					uint32_t diff_time = k_uptime_get_32() - last_chg_response_time;
					if(diff_time > 400){
						//player[0].score--;
						foul_presses++;
						//printk("Wrong button pressed (%i). -1 point. Score %i\n", bt_evt->con_index, player[0].score);
					}
				}
            }
            else if (memcmp(bt_evt->data, "TD:", 3) == 0 && bt_evt->data_len >= 9) {
                uint32_t response_time = 0;
				last_chg_response_time = k_uptime_get_32();
                for(int i = 0; i < 6; i++) {
                    response_time = response_time * 10 + (bt_evt->data[i+3] - '0');
                }
				int pad_spaces_to_print = CONSOLE_SCORE_PROGRESS_COL - console_print_progress;
				console_print_progress = -1;
				challenge_pending = false;
				//printk("Received from index %i, expected %i\n", bt_evt->con_index, player[0].chg_per_index);

				if(response_time < whackamole.target_pr_round[whackamole.current_round]) {
					challenge_finalize(response_time, whackamole.target_pr_round[whackamole.current_round],
										true, pad_spaces_to_print);
				}
				else {
					challenge_finalize(response_time, whackamole.target_pr_round[whackamole.current_round],
										false, pad_spaces_to_print);
				}

				// Add the response time to the list
				if (player[0].challenge_counter < CHALLENGE_NUM_MAX) {
					player[0].challenge_response_time_list[player[0].challenge_counter++] = response_time;

					whackamole.chg_rsp_total += response_time;
					whackamole.chg_rsp_counter++;
				}
				// Clear the challenge peripheral index to avoid double presses giving double points
				player[0].chg_per_index = -1;
            }
			else if (memcmp(bt_evt->data, "TO", 2) == 0) {
				// Challenge timed out
				int pad_spaces_to_print = CONSOLE_SCORE_PROGRESS_COL - console_print_progress;
				console_print_progress = -1;
				challenge_pending = false;
				challenge_finalize(0, whackamole.target_pr_round[whackamole.current_round], false, pad_spaces_to_print);
			}
            k_sem_give(&m_sem_peripheral_update);
            break;
    }
}

#define TICKS_PR_SEC 20
#define TIMEOUT_BUFFER_MS 300

static void whackamole_play(struct game_t *game)
{
	k_msleep(1000);
    
	printk("Welcome to Whack-A-Mole! The most exiting Bluetooth game in the world!!!\n");
    printk("Waiting for peripherals to connect...\n");
    
	whackamole.target_pr_round[0] = 1200;
	whackamole.target_pr_round[1] = 1000;
	whackamole.target_pr_round[2] = 800;
	whackamole.target_pr_round[3] = 600;
	whackamole.target_pr_round[4] = 400;
	whackamole.target_pr_round[5] = 300;
    whackamole.round_duration_s = 20 * TICKS_PR_SEC;
    whackamole.time = 0;
    whackamole.challenge_int_min = 2 * TICKS_PR_SEC;
    whackamole.challenge_int_range = 3 * TICKS_PR_SEC / 2;
	whackamole.challenges_pr_round = 10;
    whackamole.chg_rsp_total = whackamole.chg_rsp_counter = 0;
	whackamole.game_running = false;

	while (1) {
		// Waiting for players to connect
		ping_received = false;
		while (num_players < 1 || !ping_received) {
			if (k_sem_take(&m_sem_num_players_update, K_MSEC(100)) == 0) {
				printk("\rControllers connected: %i   ", num_players);
				send_per_cmd_num_con_change(num_players);	
			}
		}

		player[0].per_num = num_players;
		player[0].score = 0;
		player[0].missing_scores = 0;
		player[0].fouls = 0;
		player[0].chg_per_index = -1;

		// Use the uptime to provide a semi random seed to the random generator
		srand(k_uptime_get_32());

		printk("\n\nStarting new game\n");
		for(int i = 0; i < player[0].per_num; i++) {
			game->bt_send(i, "RST", 3);
		}
		send_per_cmd_game_start();

		k_msleep(1000);

		whackamole.game_running = true;

		// Starting first round
		k_timer_start(&m_timer_game, K_MSEC(1000 / TICKS_PR_SEC), K_MSEC(1000 / TICKS_PR_SEC));

		for(whackamole.current_round = 0; whackamole.current_round < MAX_ROUNDS; whackamole.current_round++) {
			uint32_t target_time = whackamole.target_pr_round[whackamole.current_round];
			k_msleep(750);
			
			printk("\nRound %i starting... Respond quicker than %i ms!\n", (whackamole.current_round + 1), target_time);
			send_color_effect(PER_INDEX_ALL, '0', &led_effect_new_round, 0);
			send_per_cmd_round_start(whackamole.current_round, MAX_ROUNDS, target_time);

			console_print_goal_line_index = (target_time / 50) + 2;
			for (int i = 0; i < (console_print_goal_line_index - 1); i++) printk(" ");
			printk("|\n");

			k_msleep(750);
			
			whackamole.time = 0;
			whackamole.time_until_challenge = 20;
			whackamole.challenge_index = 0;
			do {			
				k_sem_take(&m_sem_second_tick, K_FOREVER);
				if (whackamole.time >= whackamole.time_until_challenge) {	
					// Start a new challenge
					int random_peripheral_index = rand() % player[0].per_num;
					player[0].chg_per_index_previous = player[0].chg_per_index;
					player[0].chg_per_index = random_peripheral_index;
					foul_presses = 0;
					challenge_pending = true;
					send_color_effect(random_peripheral_index, '2', &led_effect_challenge, target_time + TIMEOUT_BUFFER_MS);
					console_print_progress = true;
					whackamole.time_until_challenge = whackamole.time + (target_time + 200) / TICKS_PR_SEC + rand() % whackamole.challenge_int_range;
					send_per_cmd_chg_start(random_peripheral_index, target_time);
					whackamole.challenge_index++;
				}
			} while(whackamole.challenge_index < whackamole.challenges_pr_round || challenge_pending);
		}

		// Print an end of round report
		printk("Game complete!\n");
		k_timer_stop(&m_timer_game);
		whackamole.game_running = false;

		int result, min = 1000000000, max = 0, total = 0;
		if (player[0].challenge_counter > 0) {
			printk("\nResults: \n");
			for (int i = 0; i < player[0].challenge_counter; i++) {
				result = player[0].challenge_response_time_list[i];
				//printk("  Challenge %i: Time %i ms\n", (i+1), result);
				if (result < min) min = result;
				if (result > max) max = result;
				total += result; 
			}
			printk("  Total score:  %i points\n", player[0].score);
			printk("  Best result:  %i ms\n", min);
			printk("  Worst result: %i ms\n", max);
			player[0].challenge_average = total / player[0].challenge_counter;
			printk("  Average:      %i ms\n", player[0].challenge_average);
		}
		
		send_per_cmd_game_finish(player[0].score, min, max, player[0].challenge_average);

		printk("\nPress any button to start a new game\n");
	}

}

void game_timer_func(struct k_timer *timer_id)
{
    whackamole.time++;
    k_sem_give(&m_sem_second_tick);
	if(console_print_progress >= 0) {
		(console_print_progress == console_print_goal_line_index) ? printk("|") : printk("-");
		console_print_progress++;
	}
}

int whackamole_init(struct game_t *game)
{
	this = game;
    game->play = whackamole_play;
    game->bt_rx = whackamole_bt_rx;
    num_players = 0;

    return 0;
}
```
